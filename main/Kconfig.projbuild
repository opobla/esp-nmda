## main/Kconfig.projbuild
```kconfig
menu "NMDA-ESP32 SPECIFICS"

config OTA_URL
    string "OTA binary file URL"
    default "https://github.com/diego-acc/Neutron-Monitor-Data-Acquisition/releases/download/latest/main.bin"

config OTA_HASH
    string "OTA hash file URL"
    default "https://github.com/diego-acc/Neutron-Monitor-Data-Acquisition/releases/download/latest/hash"

config OTA_TIME
    string "OTA to verify hash"
    default "3600"

config MQTT_HOST
    string "MQTT BROKER"
    default "my broker"

config MQTT_PORT
    string "MQTT PORT"
    default "1883"

config MQTT_USER
    string "MQTT USER"
    default "my mqtt user"

config MQTT_PASS
    string "MQTT_PASS"
    default "my mqtt pass"

config SPI_MOSI_PIN
    int "SPI MOSI PIN"
    default 23

config SPI_MISO_PIN
    int "SPI MISO PIN"
    default 19

config SPI_CLK_PIN 
    int "SPI CLK PIN"
    default 18

config SPI_SDCARD_CS_PIN
    int "SPI SDCARD CS PIN"
    default 5

config ENABLE_I2C_BUS
    bool "Enable I2C bus support"
    default y
    help
        Enable I2C bus initialization and management.
        This is required for HV Supply Board and other I2C devices (e.g., SPL06).
        The I2C bus is shared and can be used by multiple devices.

config I2C_BUS_SPEED
    int "I2C bus speed (Hz)"
    default 100000
    depends on ENABLE_I2C_BUS
    help
        I2C bus clock frequency in Hz.
        Standard mode: 100000 (100kHz)
        Fast mode: 400000 (400kHz)

config I2C_MASTER_SDA_IO
    int "I2C Master SDA GPIO"
    default 21
    depends on ENABLE_I2C_BUS
    help
        GPIO number for I2C Master SDA signal.
        Default: 21 (GPIO21)

config I2C_MASTER_SCL_IO
    int "I2C Master SCL GPIO"
    default 22
    depends on ENABLE_I2C_BUS
    help
        GPIO number for I2C Master SCL signal.
        Default: 22 (GPIO22)

config ENABLE_HV_SUPPORT
    bool "Enable HV Supply Board support"
    default n
    depends on ENABLE_I2C_BUS
    help
        Enable support for HVSupplyBoard V1 hardware.
        This includes I2C drivers for DAC, ADC, and Power Monitor,
        as well as HV control and monitoring functionality.
        When disabled, all HV-related code will be excluded from compilation.
        Requires I2C bus to be enabled.

config HV_ADC_I2C_ADDRESS
    hex "HV ADC (ADS112C04) I2C address"
    default 0x40
    depends on ENABLE_HV_SUPPORT
    help
        I2C address of the ADS112C04 ADC.
        Default: 0x40 (AO=DGND, A1=DGND)
        Other possible addresses:
        - 0x41 (AO=DGND, A1=DVDD)
        - 0x42 (AO=DGND, A1=SDA)
        - 0x43 (AO=DGND, A1=SCL)
        - 0x44 (AO=DVDD, A1=DGND)
        - 0x45 (AO=DVDD, A1=DVDD)
        Note: Check schematic to verify AO and A1 pin connections.

config ENABLE_SPL06
    bool "Enable SPL06-001 pressure sensor support"
    default n
    depends on ENABLE_I2C_BUS
    help
        Enable support for SPL06-001 barometric pressure sensor.
        This sensor provides pressure and temperature readings via I2C.
        When disabled, all SPL06-related code will be excluded from compilation.
        Requires I2C bus to be enabled.
        Independent of HV Supply Board support.

config SPL06_I2C_ADDRESS
    hex "SPL06 I2C address"
    default 0x77
    depends on ENABLE_SPL06
    help
        I2C address of the SPL06 sensor.
        Default: 0x77 (SDO pin connected to VDD or CSB pin connected to VDD)
        Alternative: 0x76 (SDO pin connected to GND or CSB pin connected to GND)
        Note: Use I2C bus scan to detect the actual address of your sensor.

config SPL06_STATION_ALTITUDE_M
    int "Station altitude above sea level (meters)"
    default 0
    depends on ENABLE_SPL06
    help
        Altitude of the station above sea level in meters.
        This is used to calculate QNH (pressure reduced to sea level) using AEMET formula.
        QNH = P + (H/27) where P is pressure in hPa and H is altitude in meters.
        Default: 0 (sea level)

config SPL06_PUBLISH_PERIOD_SEC
    int "SPL06 publish period (seconds)"
    default 60
    depends on ENABLE_SPL06
    help
        Period between SPL06 sensor readings and MQTT publications in seconds.
        Default: 60 seconds (1 minute)

config ENABLE_USER_LED
    bool "Enable User LED support"
    default y
    help
        Enable user LED for system status indication via blink patterns.
        The LED will indicate different system conditions (booting, WiFi, NTP, etc.)
        through configurable blink patterns.

config USER_LED_GPIO
    int "User LED GPIO number"
    default 32
    depends on ENABLE_USER_LED
    help
        GPIO number for the user LED.
        Default: 32 (GPIO32)

config USER_LED_SHORT_DURATION_MS
    int "Short blink duration (ms)"
    default 100
    depends on ENABLE_USER_LED
    help
        Duration of short blinks in milliseconds.
        Default: 100ms

config USER_LED_LONG_DURATION_MS
    int "Long blink duration (ms)"
    default 500
    depends on ENABLE_USER_LED
    help
        Duration of long blinks in milliseconds.
        Default: 500ms

config USER_LED_PAUSE_BETWEEN_BLINKS_MS
    int "Pause between blinks (ms)"
    default 200
    depends on ENABLE_USER_LED
    help
        Pause duration between individual blinks in milliseconds.
        Default: 200ms

config USER_LED_PAUSE_BETWEEN_CYCLES_MS
    int "Pause between pattern cycles (ms)"
    default 2000
    depends on ENABLE_USER_LED
    help
        Pause duration between complete pattern cycles in milliseconds.
        Default: 2000ms (2 seconds)

config ENABLE_GPIO_PULSE_DETECTION
    bool "Enable GPIO interrupt-based pulse detection"
    default y
    help
        Enable pulse detection using GPIO interrupts.
        This captures pulse events with timestamp when any edge is detected.
        When disabled, GPIO interrupt detection code will be excluded from compilation.
        Note: This can be used together with RMT pulse detection or independently.

config ENABLE_RMT_PULSE_DETECTION
    bool "Enable RMT-based pulse capture and analysis"
    default n
    help
        Enable pulse capture using RMT (Remote Control) peripheral.
        This provides high-resolution timing (12.5ns) for pulse duration and separation measurements.
        Includes coincidence detection (2 and 3 channels) and multiplicity detection.
        When disabled, all RMT-related code will be excluded from compilation.

config RMT_COINCIDENCE_TOLERANCE_US
    int "Coincidence detection tolerance window (microseconds)"
    default 10
    range 1 1000
    depends on ENABLE_RMT_PULSE_DETECTION
    help
        Time window in microseconds for detecting coincidences between channels.
        Pulses from different channels within this window are considered coincident.
        Default: 10 microseconds
        Range: 1-1000 microseconds

config RMT_MULTIPLICITY_THRESHOLD_US
    int "Multiplicity detection threshold (microseconds)"
    default 100
    range 1 10000
    depends on ENABLE_RMT_PULSE_DETECTION
    help
        Maximum separation time in microseconds for pulses to be considered part of a multiplicity group.
        Pulses on the same channel with separation less than this threshold are grouped together.
        Default: 100 microseconds
        Range: 1-10000 microseconds

config RMT_EVENT_BUFFER_SIZE
    int "RMT event buffer size per channel"
    default 100
    range 10 1000
    depends on ENABLE_RMT_PULSE_DETECTION
    help
        Size of the circular buffer for storing pulse events per channel.
        Larger buffers can handle higher event rates but consume more memory.
        Default: 100 events per channel
        Range: 10-1000 events

config RMT_GLITCH_FILTER_NS
    int "RMT glitch filter (nanoseconds)"
    default 1300
    range 0 10000
    depends on ENABLE_RMT_PULSE_DETECTION
    help
        Glitch filter duration in nanoseconds to filter out noise spikes.
        Pulses shorter than this duration will be filtered out.
        Default: 1300ns (~1.3μs)
        Range: 0-10000 nanoseconds (0 = disabled)

config RMT_RX_TIMEOUT_US
    int "RMT RX timeout for pulse end detection (microseconds)"
    default 1000
    range 10 10000
    depends on ENABLE_RMT_PULSE_DETECTION
    help
        Timeout in microseconds to detect the end of a pulse.
        If no edge is detected within this time, the pulse is considered ended.
        Default: 1000 microseconds (1ms)
        Range: 10-10000 microseconds

endmenu
```
